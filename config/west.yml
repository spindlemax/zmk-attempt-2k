## config/west.yml
```yaml
manifest:
  remotes:
    - name: zmkfirmware
      url-base: https://github.com/zmkfirmware
    - name: cdc-mkb
      url-base: https://github.com/cdc-mkb/
    - name: okke-formsma
      url-base: https://github.com/okke-formsma
  projects:
    - name: zmk
      remote: cdc-mkb
      revision: mouse-pim447
      import: app/west.yml
  self:
    path: config
```
